# file: stm32_FSM_CPP.ioc
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FREERTOS.Tasks01=TaskFSM1,25,128,fTaskFSM1,Default,NULL,Static,TaskFSM1Buffer,TaskFSM1ControlBlock;TaskFSM2,18,128,fTaskFSM2,Default,NULL,Static,TaskFSM2Buffer,TaskFSM2ControlBlock
FREERTOS.Timers01=myTimer,TimerCallback,osTimerPeriodic,Default,NULL,Static,myTimerControlBlock
Mcu.Family=STM32F1
Mcu.Name=STM32F103C(8-B)Tx
Mcu.Package=LQFP48
NVIC.PriorityGroup=NVIC_PRIORITYGROUP_4
NVIC.TIM4_IRQn=true\:15\:0\:false\:false\:true\:false\:false\:true\:true
NVIC.TimeBase=TIM4_IRQn
NVIC.TimeBaseIP=TIM4
PA13.Mode=Serial_Wire
PA13.Signal=SYS_JTMS-SWDIO
PA14.Mode=Serial_Wire
PA14.Signal=SYS_JTCK-SWCLK
PC13-TAMPER-RTC.Signal=GPIO_Output
ProjectManager.HeapSize=0x200
ProjectManager.StackSize=0x400
ProjectManager.TargetToolchain=STM32CubeIDE
RCC.APB1Freq_Value=8000000
RCC.APB2Freq_Value=8000000
VP_FREERTOS_VS_CMSIS_V2.Mode=CMSIS_V2
VP_SYS_VS_tim4.Mode=TIM4
board=custom

// file: Core/Src/main.cpp
/* USER CODE BEGIN Header */
/**
  ******************************************************************************
  * @file           : main.c
  * @brief          : Main program body
  ******************************************************************************
  * @attention
  *
  * Copyright (c) 2024 STMicroelectronics.
  * All rights reserved.
  *
  * This software is licensed under terms that can be found in the LICENSE file
  * in the root directory of this software component.
  * If no LICENSE file comes with this software, it is provided AS-IS.
  *
  ******************************************************************************
  */
/* USER CODE END Header */
#include "main.h"
#include "cmsis_os.h"

/* USER CODE BEGIN Includes */
#include "UML_FSM.hpp"
#include "FreeRTOS.h"
#include "task.h"
/* USER CODE END Includes */

typedef StaticTask_t osStaticThreadDef_t;
typedef StaticTimer_t osStaticTimerDef_t;

/* Definitions for TaskFSM1 */
osThreadId_t TaskFSM1Handle;
uint32_t TaskFSM1Buffer[ 128 ];
osStaticThreadDef_t TaskFSM1ControlBlock;
const osThreadAttr_t TaskFSM1_attributes = {
  .name = "TaskFSM1",
  .cb_mem = &TaskFSM1ControlBlock,
  .cb_size = sizeof(TaskFSM1ControlBlock),
  .stack_mem = &TaskFSM1Buffer[0],
  .stack_size = sizeof(TaskFSM1Buffer),
  .priority = (osPriority_t) osPriorityNormal1,
};
/* Definitions for TaskFSM2 */
osThreadId_t TaskFSM2Handle;
uint32_t TaskFSM2Buffer[ 128 ];
osStaticThreadDef_t TaskFSM2ControlBlock;
const osThreadAttr_t TaskFSM2_attributes = {
  .name = "TaskFSM2",
  .cb_mem = &TaskFSM2ControlBlock,
  .cb_size = sizeof(TaskFSM2ControlBlock),
  .stack_mem = &TaskFSM2Buffer[0],
  .stack_size = sizeof(TaskFSM2Buffer),
  .priority = (osPriority_t) osPriorityBelowNormal2,
};
/* Definitions for myTimer */
osTimerId_t myTimerHandle;
osStaticTimerDef_t myTimerControlBlock;
const osTimerAttr_t myTimer_attributes = {
  .name = "myTimer",
  .cb_mem = &myTimerControlBlock,
  .cb_size = sizeof(myTimerControlBlock),
};

void SystemClock_Config(void);
static void MX_GPIO_Init(void);
void fTaskFSM1(void *argument);
void fTaskFSM2(void *argument);
void TimerCallback(void *argument);

/* USER CODE BEGIN 0 */
typedef enum
{
	STATE_FSM1,
	STATE_FSM2,
STATE_BLINK_SHORT,
STATE_BLINK_LONG,
STATE_BLINK_REAL,
STATE_WHAIT_TIMER,
STATE_CHOISE_BLINK,
STATE_NUM
}State_t;

typedef enum
{
EVENT_ERROR,
EVENT_TYMER_UPDATE,
EVENT_NUM
}Event_t;

typedef enum
{
	CHOISE_GO_BLINK,
	CHOISE_WHAIT,
	CHOISE_NUM
}Choise_t;

int countRealBlink;

void f_stateBlinkShort();

void f_stateBlinkLong();

void f_stateBlinkReal();

void f_stateWhaitTimer();

void f_choiseBlink();

void stateOsDelay(uint32_t delay)
{
	osDelay(delay);
}

FiniteStateMachine fsm1;
StandardStates stateBlinkShort= fsm1.createStateStandart(STATE_BLINK_SHORT, STATE_BLINK_LONG, f_stateBlinkShort);
StandardStates stateBlinkLong = fsm1.createStateStandart(STATE_BLINK_LONG, STATE_BLINK_SHORT, f_stateBlinkLong);

FiniteStateMachine fsm2;

StandardStates stateBlinkReal= fsm2.createStateStandart(STATE_BLINK_REAL, STATE_WHAIT_TIMER, f_stateBlinkReal);
EventStates stateWhaitTimer = fsm2.createStateEvent(STATE_WHAIT_TIMER, f_stateWhaitTimer);
ChoiseStates stateChoiseBlink = fsm2.createStateChoise(STATE_CHOISE_BLINK, f_choiseBlink);

/* USER CODE END 0 */

int main(void)
{
  /* USER CODE BEGIN 1 */
	fsm1.setDelayFunctionPointer(&stateOsDelay); // Установка указателя на внешнюю функцию
	fsm2.setDelayFunctionPointer(&stateOsDelay); // Установка указателя на внешнюю функцию

	fsm1.setStartState(STATE_BLINK_SHORT);
	fsm2.setStartState(STATE_WHAIT_TIMER);
	stateWhaitTimer.addEvent(EVENT_TYMER_UPDATE, STATE_CHOISE_BLINK);
	stateChoiseBlink.addChoise(CHOISE_GO_BLINK, STATE_BLINK_REAL);
	stateChoiseBlink.addChoise(CHOISE_WHAIT, STATE_WHAIT_TIMER);
  /* USER CODE END 1 */

  /* MCU Configuration--------------------------------------------------------*/

  /* Reset of all peripherals, Initializes the Flash interface and the Systick. */
  HAL_Init();

  /* Configure the system clock */
  SystemClock_Config();

  /* Initialize all configured peripherals */
  MX_GPIO_Init();

  /* Init scheduler */
  osKernelInitialize();

  /* Create the timer(s) */
  /* creation of myTimer */
  myTimerHandle = osTimerNew(TimerCallback, osTimerPeriodic, NULL, &myTimer_attributes);

  /* Create the thread(s) */
  /* creation of TaskFSM1 */
  TaskFSM1Handle = osThreadNew(fTaskFSM1, NULL, &TaskFSM1_attributes);

  /* creation of TaskFSM2 */
  TaskFSM2Handle = osThreadNew(fTaskFSM2, NULL, &TaskFSM2_attributes);

  /* Start scheduler */
  osKernelStart();

  /* We should never get here as control is now taken by the scheduler */
  /* Infinite loop */
  while (1)
  {

  }
}

void SystemClock_Config(void)
{
  RCC_OscInitTypeDef RCC_OscInitStruct = {0};
  RCC_ClkInitTypeDef RCC_ClkInitStruct = {0};

  /** Initializes the RCC Oscillators according to the specified parameters
  * in the RCC_OscInitTypeDef structure.
  */
  RCC_OscInitStruct.OscillatorType = RCC_OSCILLATORTYPE_HSI;
  RCC_OscInitStruct.HSIState = RCC_HSI_ON;
  RCC_OscInitStruct.HSICalibrationValue = RCC_HSICALIBRATION_DEFAULT;
  RCC_OscInitStruct.PLL.PLLState = RCC_PLL_NONE;
  if (HAL_RCC_OscConfig(&RCC_OscInitStruct) != HAL_OK)
  {
    Error_Handler();
  }

  /** Initializes the CPU, AHB and APB buses clocks
  */
  RCC_ClkInitStruct.ClockType = RCC_CLOCKTYPE_HCLK|RCC_CLOCKTYPE_SYSCLK
                              |RCC_CLOCKTYPE_PCLK1|RCC_CLOCKTYPE_PCLK2;
  RCC_ClkInitStruct.SYSCLKSource = RCC_SYSCLKSOURCE_HSI;
  RCC_ClkInitStruct.AHBCLKDivider = RCC_SYSCLK_DIV1;
  RCC_ClkInitStruct.APB1CLKDivider = RCC_HCLK_DIV1;
  RCC_ClkInitStruct.APB2CLKDivider = RCC_HCLK_DIV1;

  if (HAL_RCC_ClockConfig(&RCC_ClkInitStruct, FLASH_LATENCY_0) != HAL_OK)
  {
    Error_Handler();
  }
}

static void MX_GPIO_Init(void)
{
  GPIO_InitTypeDef GPIO_InitStruct = {0};

  /* GPIO Ports Clock Enable */
  __HAL_RCC_GPIOC_CLK_ENABLE();
  __HAL_RCC_GPIOA_CLK_ENABLE();

  /*Configure GPIO pin Output Level */
  HAL_GPIO_WritePin(GPIOC, GPIO_PIN_13, GPIO_PIN_RESET);

  /*Configure GPIO pin : PC13 */
  GPIO_InitStruct.Pin = GPIO_PIN_13;
  GPIO_InitStruct.Mode = GPIO_MODE_OUTPUT_PP;
  GPIO_InitStruct.Pull = GPIO_NOPULL;
  GPIO_InitStruct.Speed = GPIO_SPEED_FREQ_LOW;
  HAL_GPIO_Init(GPIOC, &GPIO_InitStruct);

}

/* USER CODE BEGIN 4 */
void f_stateBlinkShort()
{
	const uint32_t xFrequency = 500; // 500 миллисекунд
	const TickType_t xTransitionTime = pdMS_TO_TICKS(6000); // 6 секунд
	TickType_t xLastWakeTime = xTaskGetTickCount();
	while((xTaskGetTickCount() - xLastWakeTime) < xTransitionTime)
	{
	HAL_GPIO_TogglePin(GPIOC, GPIO_PIN_13); // Выполнение действий для состояния 1
	osDelay(xFrequency); // Задержка в тиках времени FreeRTOS
	}
	fsm1.next();
	//fsm1.pState->end();
}

void f_stateBlinkLong()
{
	const uint32_t xFrequency = 1000; // 500 миллисекунд
	const TickType_t xTransitionTime = pdMS_TO_TICKS(6000); // 6 секунд
	TickType_t xLastWakeTime = xTaskGetTickCount();
	while((xTaskGetTickCount() - xLastWakeTime) < xTransitionTime)
	{
	HAL_GPIO_TogglePin(GPIOC, GPIO_PIN_13); // Выполнение действий для состояния 1
	osDelay(xFrequency); // Задержка в тиках времени FreeRTOS
	}
	fsm1.next();
}

void f_stateBlinkReal()
{
	const uint32_t xFrequency = 100; // 100 миллисекунд
	const TickType_t xTransitionTime = pdMS_TO_TICKS(2000); // 2 секунд
	TickType_t xLastWakeTime = xTaskGetTickCount();
	  while((xTaskGetTickCount() - xLastWakeTime) < xTransitionTime)
	  {
		  HAL_GPIO_TogglePin(GPIOC, GPIO_PIN_13); // Выполнение действий для состояния 1
		  osDelay(xFrequency); // Задержка в тиках времени FreeRTOS
	  }
	 fsm2.next();

}

void f_stateWhaitTimer()
{
	osTimerStart(myTimerHandle, pdMS_TO_TICKS(10000));

	fsm2.next();

}

void f_choiseBlink()
{
	if(countRealBlink>3)
		stateChoiseBlink.setChoise(CHOISE_WHAIT);
	else
	{
		stateChoiseBlink.setChoise(CHOISE_GO_BLINK);
		++countRealBlink;
	}
	fsm2.next();
}
/* USER CODE END 4 */

void fTaskFSM1(void *argument)
{
  /* USER CODE BEGIN 5 */
fsm1.stateMachine();
  /* Infinite loop */
  for(;;)
  {
    osDelay(1000);
  }
  /* USER CODE END 5 */
}

void fTaskFSM2(void *argument)
{
  /* USER CODE BEGIN fTaskFSM2 */
fsm2.stateMachine();
  /* Infinite loop */
  for(;;)
  {
    osDelay(1000);
  }
  /* USER CODE END fTaskFSM2 */
}

/* TimerCallback function */
void TimerCallback(void *argument)
{
  /* USER CODE BEGIN TimerCallback */
fsm2.sendEvent(EVENT_TYMER_UPDATE);
  /* USER CODE END TimerCallback */
}

void HAL_TIM_PeriodElapsedCallback(TIM_HandleTypeDef *htim)
{
  if (htim->Instance == TIM4) {
    HAL_IncTick();
  }
}

void Error_Handler(void)
{
  __disable_irq();
  while (1)
  {
  }
}
